## config/west.yml
```yaml
manifest:
  remotes:
    - name: zmkfirmware
      url-base: https://github.com/zmkfirmware
    - name: razilyis
      url-base: https://github.com/razilyis
    - name: caksoylar
      url-base: https://github.com/caksoylar
    - name: badjeff
      url-base: https://github.com/badjeff
  projects:
    - name: zmk
      remote: zmkfirmware
      revision: v0.3
      import: app/west.yml
    - name: zmk-pmw3610-driver
      remote: razilyis
      revision: main
    - name: zmk-rgbled-widget
      remote: caksoylar
      revision: main
    - name: zmk-input-processor-keybind
      remote: badjeff
      revision: main
  self:
    path: config
```
